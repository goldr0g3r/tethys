/begin PROJECT p "one measurement"
/begin MODULE m "one measurement"
/begin MEASUREMENT s "s" UBYTE c 1 1.0 0.0 255.0 /end MEASUREMENT
/end MODULE
/end PROJECT
