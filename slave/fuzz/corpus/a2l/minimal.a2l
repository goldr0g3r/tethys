/begin PROJECT m "minimal"
/begin MODULE m "minimal"
/end MODULE
/end PROJECT
